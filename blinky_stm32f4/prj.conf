## CMakeLists.txt
```
# File: CMakeLists.txt
 
cmake_minimum_required(VERSION 3.20.0)
 
# Locate Zephyr. ZEPHYR_BASE is set automatically by West.
find_package(Zephyr REQUIRED HINTS $ENV{ZEPHYR_BASE})
 
project(blinky)
 
# Add your source file to the 'app' target (always named 'app' in Zephyr)
target_sources(app PRIVATE src/main.c)
```

## prj.conf
```kconfig
# Enable GPIO driver subsystem (required for LED control)
CONFIG_GPIO=y
 
# Enable serial + UART console so printf() works
CONFIG_SERIAL=y
CONFIG_CONSOLE=y
CONFIG_UART_CONSOLE=y
 
# Allow printk/printf output
CONFIG_PRINTK=y
CONFIG_STDOUT_CONSOLE=y
```

## src/main.c
```c
/* File: src/main.c */
 
#include <stdio.h>
#include <zephyr/kernel.h>        /* k_msleep(), printk() */
#include <zephyr/drivers/gpio.h>  /* gpio_dt_spec, gpio_pin_configure_dt() */
 
/* How long to keep the LED on/off in milliseconds */
#define SLEEP_TIME_MS  500
 
/*
 * DT_ALIAS(led0) expands to the DeviceTree node behind the 'led0' alias.
 * GPIO_DT_SPEC_GET reads the gpios property of that node at compile time.
 * The result is a gpio_dt_spec struct with .port and .pin filled in.
 */
//expands to a device tree node and it will be expanded to something like DT_N_ALIAS_led0  
//so LED0_NODE will be have DT_N_ALIAS_led0
#define LED0_NODE DT_ALIAS(led0)
 

//I guess you need to check devivcetree_generated.h file to see if the required devicetree symbol is generated
#if !DT_NODE_HAS_STATUS(LED0_NODE, okay)
#error "led0 alias is not defined for this board"
#endif
 
static const struct gpio_dt_spec led = GPIO_DT_SPEC_GET(LED0_NODE, gpios);
 
int main(void)
{
    int ret;
 
    /* Verify the GPIO controller is ready before touching it */
    if (!gpio_is_ready_dt(&led)) {
        printf("Error: GPIO device not ready\n");
        return -ENODEV;
    }
 
    /* Configure the pin as an output, initially active (LED ON) */
    ret = gpio_pin_configure_dt(&led, GPIO_OUTPUT_ACTIVE);
    if (ret < 0) {
        printf("Error %d: pin configure failed\n", ret);
        return ret;
    }
 
    printf("Blinky running on %s\n", CONFIG_BOARD);
 
    while (1) {
        /* Toggle the pin state each iteration */
        ret = gpio_pin_toggle_dt(&led);
        if (ret < 0) { return ret; }
 
        /* Yield to the Zephyr scheduler for SLEEP_TIME_MS milliseconds */
        k_msleep(SLEEP_TIME_MS);
    }
 
    return 0;
}
```
